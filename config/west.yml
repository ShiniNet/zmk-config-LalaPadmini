## config/west.yml
```yaml
manifest:
  remotes:
    - name: zmkfirmware
      url-base: https://github.com/zmkfirmware
    - name: ShiniNet
      url-base: https://github.com/ShiniNet/
    - name: caksoylar 
      url-base: https://github.com/caksoylar  
  projects:
    - name: zmk
      remote: zmkfirmware
      revision: v0.3.0
      import: app/west.yml
    - name: cirque-input-module
      remote: ShiniNet
      revision: main
    - name: zmk-rgbled-widget
      remote: caksoylar
      revision: v0.3
  self:
    path: config
```
